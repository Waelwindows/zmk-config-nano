## config/west.yml
```yaml
#manifest:
#  remotes:
#    - name: zmkfirmware
#      url-base: https://github.com/zmkfirmware
#  projects:
#    - name: zmk
#      remote: zmkfirmware
#      revision: 
#      import: app/west.yml
#  self:
#    path: config

manifest:
  remotes:
    - name: zmkfirmware
      url-base: https://github.com/petejohanson
    - name: inorichi
      url-base: https://github.com/inorichi
  projects:
    - name: zmk
      remote: zmkfirmware
      revision: 
      import: app/west.yml
    - name: zmk-pmw3610-driver
      remote: inorichi
      revision: 
  self:
    path: config
```
